## atf-20250711/plat/mediatek/mt7986/Config.in
```kconfig
# SPDX-License-Identifier: GPL-2.0 OR BSD-3-Clause
#
# Copyright (c) 2026 Yuzhii0718
#
# MT7986 platform-specific configurations
#

if _PLAT_MT7986

choice
    prompt "MT7986 ARMPLL frequency (MHz)"
    depends on _PLAT_MT7986
	default MT7986_ARMPLL_FREQ_2000

config MT7986_ARMPLL_FREQ_1600
	bool "1600 MHz"
config MT7986_ARMPLL_FREQ_1700
	bool "1700 MHz"
config MT7986_ARMPLL_FREQ_1800
	bool "1800 MHz"
config MT7986_ARMPLL_FREQ_1900
	bool "1900 MHz"
config MT7986_ARMPLL_FREQ_2000
    bool "2000 MHz (default)"
config MT7986_ARMPLL_FREQ_2100
    bool "2100 MHz"
config MT7986_ARMPLL_FREQ_2200
    bool "2200 MHz"
config MT7986_ARMPLL_FREQ_2300
    bool "2300 MHz"
config MT7986_ARMPLL_FREQ_2400
    bool "2400 MHz"
config MT7986_ARMPLL_FREQ_2500
    bool "2500 MHz"

endchoice

# Makefile/C option bridge for MT7986 ARMPLL frequency selection.
config MT7986_ARMPLL_FREQ_MHZ
	int
	depends on _PLAT_MT7986
	default 1600 if MT7986_ARMPLL_FREQ_1600
	default 1700 if MT7986_ARMPLL_FREQ_1700
	default 1800 if MT7986_ARMPLL_FREQ_1800
	default 1900 if MT7986_ARMPLL_FREQ_1900
	default 2000 if MT7986_ARMPLL_FREQ_2000
	default 2100 if MT7986_ARMPLL_FREQ_2100
	default 2200 if MT7986_ARMPLL_FREQ_2200
	default 2300 if MT7986_ARMPLL_FREQ_2300
	default 2400 if MT7986_ARMPLL_FREQ_2400
	default 2500 if MT7986_ARMPLL_FREQ_2500

choice
	prompt "MT7986 TRNG interface version"
	depends on _PLAT_MT7986
	default MT7986_TRNG_V1

config MT7986_TRNG_V1
	bool "v1 (default)"

config MT7986_TRNG_V2
	bool "v2"

endchoice

# Makefile/C option bridge for MT7986 TRNG interface version selection.
config MT7986_TRNG_VERSION
	int
	depends on _PLAT_MT7986
	default 1 if MT7986_TRNG_V1
	default 2 if MT7986_TRNG_V2

config _MT7986_TRNG_NS_ACCESS
	bool "Allow non-secure world to access TRNG registers directly"
	default n
	help
	  By default BL31 restricts the TRNG to secure world only and exposes
	  random numbers through the MTK_SIP_TRNG_GET_RND SMC call.
	  Vendor firmwares based on the MediaTek SDK kernel 5.4 read the TRNG
	  registers directly and fail (hwrng errors) with this restriction.
	  Say Y here to keep both the SMC interface and direct register access
	  working, e.g. for boards which must boot both stock and OpenWrt
	  firmware.

# Makefile option
config MT7986_TRNG_NS_ACCESS
	int
	default 1
	depends on _MT7986_TRNG_NS_ACCESS

endif # _PLAT_MT7986
```

## atf-20260123/plat/mediatek/mt7986/Config.in
```kconfig
# SPDX-License-Identifier: BSD-3-Clause
#
# MT7986 platform-specific configurations
#

if _PLAT_MT7986

config _MT7986_TRNG_NS_ACCESS
	bool "Allow non-secure world to access TRNG registers directly"
	default n
	help
	  By default BL31 restricts the TRNG to secure world only and exposes
	  random numbers through the MTK_SIP_TRNG_GET_RND SMC call.
	  Vendor firmwares based on the MediaTek SDK kernel 5.4 read the TRNG
	  registers directly and fail (hwrng errors) with this restriction.
	  Say Y here to keep both the SMC interface and direct register access
	  working, e.g. for boards which must boot both stock and OpenWrt
	  firmware.

# Makefile option
config MT7986_TRNG_NS_ACCESS
	int
	default 1
	depends on _MT7986_TRNG_NS_ACCESS

endif # _PLAT_MT7986
```

## uboot-mtk-20250711/configs/mt7987_cudy_tr3600_defconfig
```kconfig
CONFIG_ARM=y
CONFIG_SYS_HAS_NONCACHED_MEMORY=y
CONFIG_POSITION_INDEPENDENT=y
CONFIG_ARCH_MEDIATEK=y
CONFIG_TEXT_BASE=0x41e00000
CONFIG_SYS_MALLOC_F_LEN=0x4000
CONFIG_NR_DRAM_BANKS=1
CONFIG_ENV_SIZE=0x80000
CONFIG_DEFAULT_DEVICE_TREE="mt7987a-cudy-tr3600"
CONFIG_TARGET_MT7987=y
CONFIG_SYS_BOOTM_LEN=0x6000000
CONFIG_SYS_LOAD_ADDR=0x48000000
CONFIG_DEBUG_UART_BASE=0x11000000
CONFIG_DEBUG_UART_CLOCK=40000000
CONFIG_DEBUG_UART=y
CONFIG_MEDIATEK_BOOTMENU=y
CONFIG_MEDIATEK_BOOTMENU_DELAY=3
CONFIG_MEDIATEK_LOAD_FROM_RAM=y
CONFIG_MTK_WEB_FAILSAFE=y
CONFIG_MTK_WEB_FAILSAFE_AFTER_BOOT_FAILURE=y
CONFIG_MTK_UBI_SUPPORT=y
CONFIG_MTK_UBI_RESERVED_VOLUMES="u-boot-env=1m"
CONFIG_MTK_DUAL_BOOT=y
# CONFIG_MTK_DUAL_BOOT_IMAGE_ROOTFS_VERIFY is not set
CONFIG_MTK_DUAL_BOOT_ROOTFS_DATA_SIZE=140
CONFIG_MTK_UPGRADE_BL2_VERIFY=y
CONFIG_MTK_UPGRADE_FIP_VERIFY=y
# CONFIG_MTK_UPGRADE_IMAGE_VERIFY is not set
CONFIG_ENABLE_NAND_NMBM=y
CONFIG_FIT=y
CONFIG_AUTOBOOT_MENU_SHOW=y
CONFIG_AUTOBOOT_MENU_MTK_SHOW=y
CONFIG_DEFAULT_FDT_FILE="mt7987a-cudy-tr3600"
CONFIG_SYS_CBSIZE=512
CONFIG_SYS_PBSIZE=1049
CONFIG_LOGLEVEL=7
CONFIG_LOG=y
# CONFIG_BOARD_INIT is not set
CONFIG_SYS_PROMPT="TR3600> "
# CONFIG_BOOTM_NETBSD is not set
# CONFIG_BOOTM_PLAN9 is not set
# CONFIG_BOOTM_RTEMS is not set
# CONFIG_BOOTM_VXWORKS is not set
# CONFIG_CMD_ELF is not set
# CONFIG_CMD_XIMG is not set
# CONFIG_CMD_UNLZ4 is not set
# CONFIG_CMD_UNZIP is not set
CONFIG_CMD_CLK=y
CONFIG_CMD_DM=y
CONFIG_CMD_GPIO=y
CONFIG_CMD_GPIO_READ=y
CONFIG_CMD_PWM=y
CONFIG_CMD_I2C=y
CONFIG_CMD_MTD=y
CONFIG_CMD_MTDPARTS=y
CONFIG_CMD_NMBM=y
CONFIG_CMD_SF_TEST=y
CONFIG_CMD_MII=y
CONFIG_CMD_PING=y
CONFIG_CMD_PSTORE=y
CONFIG_CMD_PSTORE_MEM_ADDR=0x0
CONFIG_CMD_PSTORE_RECORD_SIZE=0x2000
CONFIG_CMD_PSTORE_CONSOLE_SIZE=0x2000
CONFIG_CMD_PSTORE_FTRACE_SIZE=0x0
CONFIG_CMD_PSTORE_PMSG_SIZE=0x2000
CONFIG_CMD_SMC=y
CONFIG_CMD_GL_BTN=y
CONFIG_CMD_SHOW_MTD_LAYOUT=y
CONFIG_MTDIDS_DEFAULT="nmbm0=nmbm0"
CONFIG_MTDPARTS_DEFAULT="nmbm0:1024k(bl2),512k(backup),4096k(factory),256k(bdinfo),2048k(fip),237824k(ubi)"
CONFIG_ENV_OVERWRITE=y
CONFIG_ENV_IS_IN_UBI=y
CONFIG_ENV_UBI_PART="ubi"
CONFIG_ENV_UBI_VOLUME="u-boot-env"
CONFIG_ENV_VARS_UBOOT_RUNTIME_CONFIG=y
CONFIG_USE_IPADDR=y
CONFIG_IPADDR="192.168.1.1"
CONFIG_USE_NETMASK=y
CONFIG_NETMASK="255.255.255.0"
CONFIG_USE_SERVERIP=y
CONFIG_SERVERIP="192.168.1.2"
CONFIG_NET_RANDOM_ETHADDR=y
CONFIG_PROT_TCP=y
CONFIG_REGMAP=y
CONFIG_SYSCON=y
CONFIG_BUTTON=y
CONFIG_BUTTON_GPIO=y
CONFIG_CLK=y
CONFIG_DM_I2C=y
CONFIG_SYS_I2C_MTK=y
CONFIG_LED=y
CONFIG_LED_BLINK=y
CONFIG_LED_GPIO=y
# CONFIG_MMC is not set
CONFIG_DM_MTD=y
CONFIG_MTD_SPI_NAND=y
CONFIG_DM_SPI_FLASH=y
CONFIG_SPI_FLASH_EON=y
CONFIG_SPI_FLASH_GIGADEVICE=y
CONFIG_SPI_FLASH_ISSI=y
CONFIG_SPI_FLASH_MACRONIX=y
CONFIG_SPI_FLASH_SPANSION=y
CONFIG_SPI_FLASH_STMICRO=y
CONFIG_SPI_FLASH_WINBOND=y
CONFIG_PHY_MEDIATEK_2P5GE=y
CONFIG_PHY_REALTEK=y
CONFIG_PHY_ETHERNET_ID=y
CONFIG_PHY_FIXED=y
CONFIG_MEDIATEK_ETH=y
CONFIG_PINCTRL=y
CONFIG_PINCONF=y
CONFIG_PINCTRL_MT7987=y
CONFIG_POWER_DOMAIN=y
CONFIG_MTK_POWER_DOMAIN=y
CONFIG_DM_PWM=y
CONFIG_PWM_MTK=y
CONFIG_DM_SERIAL=y
CONFIG_MTK_SERIAL=y
CONFIG_SPI=y
CONFIG_DM_SPI=y
CONFIG_MTK_SPIM=y
CONFIG_XZ=y
CONFIG_HEXDUMP=y
CONFIG_MD5=y
# CONFIG_EFI_LOADER is not set
```
