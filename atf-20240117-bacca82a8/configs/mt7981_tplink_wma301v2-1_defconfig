## uboot-mtk-20250711/configs-openwrt/mt7981_livinet_li320_defconfig
```kconfig
CONFIG_ARM=y
CONFIG_ARM_SMCCC=y
CONFIG_SYS_HAS_NONCACHED_MEMORY=y
CONFIG_POSITION_INDEPENDENT=y
CONFIG_ARCH_MEDIATEK=y
CONFIG_TEXT_BASE=0x41e00000
CONFIG_SYS_MALLOC_F_LEN=0x4000
CONFIG_NR_DRAM_BANKS=1
CONFIG_DEFAULT_DEVICE_TREE="mediatek/openwrt/mt7981-livinet-li320"
CONFIG_OF_LIBFDT_OVERLAY=y
CONFIG_TARGET_MT7981=y
CONFIG_SYS_LOAD_ADDR=0x46000000
CONFIG_PRE_CON_BUF_ADDR=0x4007EF00
CONFIG_DEBUG_UART_BASE=0x11002000
CONFIG_DEBUG_UART_CLOCK=40000000
CONFIG_DEBUG_UART=y
CONFIG_FIT=y
CONFIG_BOOTDELAY=30
CONFIG_AUTOBOOT_KEYED=y
CONFIG_AUTOBOOT_MENU_SHOW=y
CONFIG_DEFAULT_FDT_FILE="mediatek/mt7981-livinet-li320.dtb"
CONFIG_LOGLEVEL=7
CONFIG_PRE_CONSOLE_BUFFER=y
CONFIG_LOG=y
CONFIG_HUSH_PARSER=y
CONFIG_SYS_PROMPT="MT7981> "
CONFIG_CMD_CPU=y
CONFIG_CMD_LICENSE=y
CONFIG_CMD_BOOTMENU=y
CONFIG_CMD_ASKENV=y
CONFIG_CMD_ERASEENV=y
CONFIG_CMD_ENV_FLAGS=y
CONFIG_CMD_RNG=y
CONFIG_CMD_STRINGS=y
CONFIG_CMD_DM=y
CONFIG_CMD_GPIO=y
CONFIG_CMD_GPT=y
CONFIG_CMD_MTD=y
CONFIG_CMD_PART=y
CONFIG_CMD_TFTPSRV=y
CONFIG_CMD_RARP=y
CONFIG_CMD_CDP=y
CONFIG_CMD_SNTP=y
CONFIG_CMD_LINK_LOCAL=y
CONFIG_CMD_DHCP=y
CONFIG_CMD_DNS=y
CONFIG_CMD_PING=y
CONFIG_CMD_PXE=y
CONFIG_CMD_CACHE=y
CONFIG_CMD_PSTORE=y
CONFIG_CMD_PSTORE_MEM_ADDR=0x42ff0000
CONFIG_CMD_UUID=y
CONFIG_CMD_HASH=y
CONFIG_CMD_SMC=y
CONFIG_CMD_UBI=y
CONFIG_CMD_UBI_RENAME=y
CONFIG_OF_EMBED=y
CONFIG_ENV_OVERWRITE=y
CONFIG_ENV_IS_IN_UBI=y
CONFIG_ENV_REDUNDANT=y
CONFIG_ENV_UBI_PART="ubi"
CONFIG_ENV_UBI_VOLUME="ubootenv"
CONFIG_ENV_UBI_VOLUME_REDUND="ubootenv2"
CONFIG_ENV_RELOC_GD_ENV_ADDR=y
CONFIG_ENV_USE_DEFAULT_ENV_TEXT_FILE=y
CONFIG_ENV_DEFAULT_ENV_TEXT_FILE="defenvs/livinet_li320_env"
CONFIG_ENV_VARS_UBOOT_RUNTIME_CONFIG=y
CONFIG_VERSION_VARIABLE=y
CONFIG_NETCONSOLE=y
CONFIG_USE_IPADDR=y
CONFIG_IPADDR="192.168.1.1"
CONFIG_USE_SERVERIP=y
CONFIG_SERVERIP="192.168.1.254"
CONFIG_NET_RANDOM_ETHADDR=y
CONFIG_REGMAP=y
CONFIG_SYSCON=y
CONFIG_BUTTON=y
CONFIG_BUTTON_GPIO=y
CONFIG_CLK=y
CONFIG_GPIO_HOG=y
CONFIG_LED=y
CONFIG_LED_BLINK=y
CONFIG_LED_GPIO=y
# CONFIG_MMC is not set
CONFIG_MTD=y
CONFIG_DM_MTD=y
CONFIG_MTD_SPI_NAND=y
CONFIG_MTD_UBI_FASTMAP=y
CONFIG_PHY_FIXED=y
CONFIG_MEDIATEK_ETH=y
CONFIG_PHY=y
CONFIG_PINCTRL=y
CONFIG_PINCONF=y
CONFIG_PINCTRL_MT7981=y
CONFIG_POWER_DOMAIN=y
CONFIG_MTK_POWER_DOMAIN=y
CONFIG_DM_REGULATOR=y
CONFIG_DM_REGULATOR_FIXED=y
CONFIG_DM_REGULATOR_GPIO=y
CONFIG_RAM=y
CONFIG_DM_RNG=y
CONFIG_RNG_MTK_V2=y
CONFIG_DM_SERIAL=y
CONFIG_MTK_SERIAL=y
CONFIG_SPI=y
CONFIG_DM_SPI=y
CONFIG_MTK_SPIM=y
CONFIG_ZSTD=y
CONFIG_HEXDUMP=y
```

## uboot-mtk-20250711/drivers/mtd/nand/spi/Kconfig
```kconfig
menuconfig MTD_SPI_NAND
	bool "SPI NAND device Support"
	depends on DM_MTD && DM_SPI
	select MTD_NAND_CORE
	select SPI_MEM
	help
	  This is the framework for the SPI NAND device drivers.

config MTD_SPI_NAND_DEVICE_AUTOSELECT
	bool "Autoselect SPI Nand flash"
	default y
	help
	  By default, auto-selects frequent used SPI Nand flash chips.
	  Enable by default: DOSILICON, ESMT, ETRON, FMSH, FORESEE, 
	  GIGADEVICE, GSTO, MACRONIX, MICRON, PARAGON, SKYHIGH, TOSHIBA,
	  WINBOND, WODPOSIT, XTX.
	  Disable by default: ALLIANCEMEMORY, ATO, BIWIN, HIKSEMI, HYF,
	  JSC, SILICONGO, UNIM, XINCUN, ZBIT.
	  If you want to add support for more SPI Nand flash chips,
	  please enable the corresponding option below.

config MTD_SPI_NAND_ALLIANCEMEMORY
	bool "ALLIANCEMEMORY SPI flash support"
	default n if MTD_SPI_NAND_DEVICE_AUTOSELECT
	help
	  Add support for various ALLIANCEMEMORY SPI Nand flash chips

config MTD_SPI_NAND_ATO
	bool "ATO SPI flash support"
	default n if MTD_SPI_NAND_DEVICE_AUTOSELECT
	help
	  Add support for various ATO SPI Nand flash chips

config MTD_SPI_NAND_BIWIN
	bool "BIWIN SPI flash support"
	default n if MTD_SPI_NAND_DEVICE_AUTOSELECT
	help
	  Add support for various BIWIN SPI Nand flash chips

config MTD_SPI_NAND_DOSILICON
	bool "DOSILICON SPI flash support"
	default y if MTD_SPI_NAND_DEVICE_AUTOSELECT
	help
	  Add support for various DOSILICON SPI Nand flash chips

config MTD_SPI_NAND_ESMT
	bool "ESMT SPI flash support"
	default y if MTD_SPI_NAND_DEVICE_AUTOSELECT
	select SPI_NAND_MICRON
	help
	  Add support for various ESMT SPI Nand flash chips

config MTD_SPI_NAND_ETRON
	bool "ETRON SPI flash support"
	default y if MTD_SPI_NAND_DEVICE_AUTOSELECT
	help
	  Add support for various ETRON SPI Nand flash chips

config MTD_SPI_NAND_FMSH
	bool "FMSH SPI flash support"
	default y if MTD_SPI_NAND_DEVICE_AUTOSELECT
	help
	  Add support for various FMSH SPI Nand flash chips

config MTD_SPI_NAND_FORESEE
	bool "FORESEE SPI flash support"
	default y if MTD_SPI_NAND_DEVICE_AUTOSELECT
	help
	  Add support for various FORESEE SPI Nand flash chips

config MTD_SPI_NAND_GIGADEVICE
	bool "GIGADEVICE SPI flash support"
	default y if MTD_SPI_NAND_DEVICE_AUTOSELECT
	help
	  Add support for various GIGADEVICE SPI Nand flash chips

config MTD_SPI_NAND_GSTO
	bool "GSTO SPI flash support"
	default y if MTD_SPI_NAND_DEVICE_AUTOSELECT
	help
	  Add support for various GSTO SPI Nand flash chips

config MTD_SPI_NAND_HIKSEMI
	bool "HIKSEMI SPI flash support"
	default n if MTD_SPI_NAND_DEVICE_AUTOSELECT
	help
	  Add support for various HIKSEMI SPI Nand flash chips

config MTD_SPI_NAND_HYF
	bool "HYF SPI flash support"
	default n if MTD_SPI_NAND_DEVICE_AUTOSELECT
	help
	  Add support for various HYF SPI Nand flash chips

config MTD_SPI_NAND_JSC
	bool "JSC SPI flash support"
	default n if MTD_SPI_NAND_DEVICE_AUTOSELECT
	help
	  Add support for various JSC SPI Nand flash chips

config MTD_SPI_NAND_MACRONIX
	bool "MACRONIX SPI flash support"
	default y if MTD_SPI_NAND_DEVICE_AUTOSELECT
	help
	  Add support for various MACRONIX SPI Nand flash chips

config MTD_SPI_NAND_MICRON
	bool "MICRON SPI flash support"
	default y if MTD_SPI_NAND_DEVICE_AUTOSELECT
	help
	  Add support for various MICRON SPI Nand flash chips

config MTD_SPI_NAND_PARAGON
	bool "PARAGON SPI flash support"
	default y if MTD_SPI_NAND_DEVICE_AUTOSELECT
	help
	  Add support for various PARAGON SPI Nand flash chips

config MTD_SPI_NAND_SILICONGO
	bool "SILICONGO SPI flash support"
	default n if MTD_SPI_NAND_DEVICE_AUTOSELECT
	help
	  Add support for various SILICONGO SPI Nand flash chips

config MTD_SPI_NAND_SKYHIGH
	bool "SKYHIGH SPI flash support"
	default y if MTD_SPI_NAND_DEVICE_AUTOSELECT
	help
	  Add support for various SKYHIGH SPI Nand flash chips

config MTD_SPI_NAND_TOSHIBA
	bool "TOSHIBA SPI flash support"
	default y if MTD_SPI_NAND_DEVICE_AUTOSELECT
	help
	  Add support for various TOSHIBA SPI Nand flash chips

config MTD_SPI_NAND_UNIM
	bool "UNIM SPI flash support"
	default n if MTD_SPI_NAND_DEVICE_AUTOSELECT
	help
	  Add support for various UNIM SPI Nand flash chips

config MTD_SPI_NAND_WINBOND
	bool "WINBOND SPI flash support"
	default y if MTD_SPI_NAND_DEVICE_AUTOSELECT
	help
	  Add support for various WINBOND SPI Nand flash chips

config MTD_SPI_NAND_WODPOSIT
	bool "WODPOSIT SPI flash support"
	default y if MTD_SPI_NAND_DEVICE_AUTOSELECT
	help
	  Add support for various WODPOSIT SPI Nand flash chips

config MTD_SPI_NAND_XINCUN
	bool "XINCUN SPI flash support"
	default n if MTD_SPI_NAND_DEVICE_AUTOSELECT
	help
	  Add support for various XINCUN SPI Nand flash chips

config MTD_SPI_NAND_XTX
	bool "XTX SPI flash support"
	default y if MTD_SPI_NAND_DEVICE_AUTOSELECT
	select MTD_SPI_NAND_MICRON
	help
	  Add support for various XTX SPI Nand flash chips

config MTD_SPI_NAND_ZBIT
	bool "ZBIT SPI flash support"
	default n if MTD_SPI_NAND_DEVICE_AUTOSELECT
	help
	  Add support for various ZBIT SPI Nand flash chips
```
